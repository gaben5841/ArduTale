//oh boy convoluted code time
#include <Arduboy2.h>
#include <ArduboyPlaytune.h>
Arduboy2 arduboy;
//variables declared (many, many variables)
int gamestate = 0;
int health = 20;
int frame = 0;
const int spriteFrame1 = 0;
const int spriteFrame2 = 1;
const int frameUpdates = 30;
int heartX = 32;
int heartY = 32;
const int playerH = 5;
const int playerW = 5;
int playerBoxH = 40;
int bubbleX = 20;
int bubbleY = 25;
float yMove = 1;
float xMove = 1.2;
//bool hasAttacked = false;



//sprites declared
const unsigned char PROGMEM titleScreen[] =
{
// width, height,
128, 64,
0x00, 0x00, 0xf0, 0xf8, 0xfc, 0x00, 0x80, 0xfc, 0xfc, 0xfc, 0x00, 0x00,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 0x00, 
0x00, 0x00, 0x87, 0x87, 0x87, 0x87, 0x87, 0x07, 0x07, 0x07, 0x00, 0x80,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 0x00, 
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0x00, 0x00, 0x00, 0x00, 0x00, 0x00, 0x00, 0x00, 0x00, 0x00, 0x00, 0x00,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 0x00, 
};
/*
const unsigned char arduman1[] PROGMEM = {
  0x00, 0x00, 0x00, 0xff, 0xfd, 0x3, 0x33, 0x33, 0x3, 0x3, 0x23, 0x43, 0x43, 0x23, 0x3, 0x3, 0x33, 0x33, 0x3, 0xfd, 0xff, 0x00, 0x00, 0x00, 0x1c, 0x2, 0x1, 0xff, 0xff, 0xfc, 0x3c, 0x3c, 0x38, 0xf8, 0xf8, 0xf8, 0xf8, 0xf8, 0xf8, 0xf8, 0xfc, 0xfc, 0xfc, 0xff, 0xff, 0x1, 0x2, 0x1c, 0x00, 0x00, 0x00, 0xff, 0x78, 0xf8, 0xe5, 0xe2, 0xe5, 0xf8, 0xf8, 0xff, 0xff, 0xe3, 0xe3, 0xe3, 0xff, 0xf8, 0xf8, 0x78, 0xff, 0x00, 0x00, 0x00, 0x00, 0x00, 0x00, 0x9, 0x9, 0xf, 0x1, 0x1, 0x1, 0x1, 0x1, 0x1, 0x1, 0x1, 0x1, 0x1, 0x1, 0x1, 0xf, 0x9, 0x9, 0x00, 0x00, 0x00, 
};

const unsigned char arduman2[] PROGMEM = {
  0x00, 0x00, 0x00, 0xfe, 0xfa, 0x6, 0x66, 0x66, 0x6, 0x6, 0x46, 0x86, 0x86, 0x46, 0x6, 0x6, 0x66, 0x66, 0x6, 0xfa, 0xfe, 0x00, 0x00, 0x00, 0x70, 0x8, 0x4, 0xff, 0xff, 0xf8, 0x78, 0x78, 0x70, 0xf0, 0xf0, 0xf0, 0xf0, 0xf0, 0xf0, 0xf0, 0xf8, 0xf8, 0xf8, 0xff, 0xff, 0x4, 0x8, 0x70, 0x00, 0x00, 0x00, 0xff, 0xf1, 0xf1, 0xca, 0xc4, 0xca, 0xf1, 0xf1, 0xff, 0xff, 0xc7, 0xc7, 0xc7, 0xff, 0xf1, 0xf1, 0xf1, 0xff, 0x00, 0x00, 0x00, 0x00, 0x00, 0x00, 0xb, 0xa, 0xf, 0x3, 0x3, 0x3, 0x3, 0x3, 0x3, 0x3, 0x3, 0x3, 0x3, 0x3, 0x3, 0xf, 0xa, 0xb, 0x00, 0x00, 0x00, 
};
*/
uint8_t const arduman[] PROGMEM =
{
  // Dimensions
  24, 28,

  // Frame 0 - Frame0
  0x00, 0x00, 0x00, 0xFF, 0xFD, 0x03, 0x33, 0x33, 0x03, 0x03, 0x23, 0x43, 0x43, 0x23, 0x03, 0x03, 0x33, 0x33, 0x03, 0xFD, 0xFF, 0x00, 0x00, 0x00,
  0x1C, 0x02, 0x01, 0xFF, 0xFF, 0xFC, 0x3C, 0x3C, 0x38, 0xF8, 0xF8, 0xF8, 0xF8, 0xF8, 0xF8, 0xF8, 0xFC, 0xFC, 0xFC, 0xFF, 0xFF, 0x01, 0x02, 0x1C,
  0x00, 0x00, 0x00, 0xFF, 0x78, 0xF8, 0xE5, 0xE2, 0xE5, 0xF8, 0xF8, 0xFF, 0xFF, 0xE3, 0xE3, 0xE3, 0xFF, 0xF8, 0xF8, 0x78, 0xFF, 0x00, 0x00, 0x00,
  0x00, 0x00, 0x00, 0x09, 0x09, 0x0F, 0x01, 0x01, 0x01, 0x01, 0x01, 0x01, 0x01, 0x01, 0x01, 0x01, 0x01, 0x01, 0x0F, 0x09, 0x09, 0x00, 0x00, 0x00,

  // Frame 1 - Frame1
  0x00, 0x00, 0x00, 0xFE, 0xFA, 0x06, 0x66, 0x66, 0x06, 0x06, 0x46, 0x86, 0x86, 0x46, 0x06, 0x06, 0x66, 0x66, 0x06, 0xFA, 0xFE, 0x00, 0x00, 0x00,
  0x70, 0x08, 0x04, 0xFF, 0xFF, 0xF8, 0x78, 0x78, 0x70, 0xF0, 0xF0, 0xF0, 0xF0, 0xF0, 0xF0, 0xF0, 0xF8, 0xF8, 0xF8, 0xFF, 0xFF, 0x04, 0x08, 0x70,
  0x00, 0x00, 0x00, 0xFF, 0xF1, 0xF1, 0xCA, 0xC4, 0xCA, 0xF1, 0xF1, 0xFF, 0xFF, 0xC7, 0xC7, 0xC7, 0xFF, 0xF1, 0xF1, 0xF1, 0xFF, 0x00, 0x00, 0x00,
  0x00, 0x00, 0x00, 0x0B, 0x0A, 0x0F, 0x03, 0x03, 0x03, 0x03, 0x03, 0x03, 0x03, 0x03, 0x03, 0x03, 0x03, 0x03, 0x0F, 0x0A, 0x0B, 0x00, 0x00, 0x00,
};



const unsigned char heart[] PROGMEM = {
  0x6, 0xf, 0x1e, 0xf, 0x6, 
};

void setup() {
  // put your setup code here, to run once:
  arduboy.begin();
  arduboy.clear();
  //arduboy.setFrameRate(60);
}

void loop() {
  // put your main code here, to run repeatedly:
  if(!arduboy.nextFrame()) {
    return;
  }
  switch(gamestate) {
    case 0:
      //title screen start
      title();
      break;
    case 1:
      //begin game
      game();
      break;
  }
}

void title() {
  arduboy.clear();
  
  arduboy.drawBitmap(-2, 0, titleScreen, 128, 64, WHITE);
  arduboy.display();

  if (arduboy.pressed(A_BUTTON)) {
    gamestate++;
  }
}

void game() {
  arduboy.clear();
  
  updateSprite();
  
  drawSprite();
  
  detectCollision(); // detects if bubble has hit walls of box
  
  //attackSelect(); <-- do not pay attention to this (it is poopoo)
  
  bubbleBounce(); // bounces bubble
  
  arduboy.print(health);
  arduboy.drawRect(0, 8, 64, playerBoxH, WHITE);
  arduboy.drawRect(70, 40, 58, 24);
  arduboy.drawBitmap(heartX, heartY, heart, playerW, playerH, WHITE);
  arduboy.display();

  if (health == 0) {
    health = 20;
    heartX = 32;
    heartY = 32;
    hasAttacked = true;
    gamestate = 0;
  }

  //button detection
  
  if (arduboy.pressed(B_BUTTON)) {
    health = 20;
    heartX = 32;
    heartY = 32;
    hasAttacked = true;
    gamestate = 0;
  }
  
  if (arduboy.pressed(RIGHT_BUTTON) && heartX < 58) {
     heartX = heartX + 2;
  }
    
  if (arduboy.pressed(LEFT_BUTTON) && heartX > 2) {
    heartX = heartX - 2;
  }

  if (arduboy.pressed(UP_BUTTON) && heartY > 10) {
    heartY = heartY - 2;
  }

  if (arduboy.pressed(DOWN_BUTTON) && heartY < 42) {
    heartY = heartY + 2;
  }
}

void updateSprite() {
  if (arduboy.everyXFrames(frameUpdates)) {
    
    if (frame < spriteFrame2) {
      frame++;
    } else {
      frame = spriteFrame1;
    }
  }
}

void drawSprite() {
  Sprites::drawSelfMasked(88, 10, arduman, frame);
}

void detectCollision() {
  if (arduboy.everyXFrames(30)) {
    if (heartX < bubbleX + 10 && heartX > bubbleX - 10 && heartY < bubbleY + 10 && heartY > bubbleY - 10) {
      health -= 1;
    }
  }
}

/*
void attackSelect() {
  if (hasAttacked == false) {
    if (frameCount == 600){ <-- don't need that yet
      bubbleBounce();
    } else {
      hasAttacked = true;
    }
  }
}
*/

void bubbleBounce() {
  arduboy.drawCircle(bubbleX, bubbleY, 10);
  bubbleX += xMove;
  bubbleY += yMove;

  if (bubbleX + 10 >= 60) {
    xMove = -0.2;
  }
  if (bubbleX - 10 <= 0) {
    xMove = 1.2;
  }
  if (bubbleY - 10 <= 8) {
    yMove = 1.2;
  }
  if (bubbleY + 10 >= 48) {
    yMove = -0.2;
  }
}
